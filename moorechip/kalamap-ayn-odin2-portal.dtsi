#include "kalamap-moorechip-common.dtsi"
#include "kalamap-moorechip-joystick-mappable.dtsi"
#include "kalamap-moorechip-joystick-xbox.dtsi"
#include "kalamap-moorechip-lighting-htr3212.dtsi"

&chosen {
	bootargs = "console=null kpti=0 log_buf_len=256K kernel.panic_on_rcu_stall=1 service_locator.enable=1 msm_rtb.filter=0x237 rcupdate.rcu_expedited=1 rcu_nocbs=0-7 ftrace_dump_on_oops swiotlb=noforce loop.max_part=7 fw_devlink.strict=1 allow_mismatched_32bit_el0 cpufreq.default_governor=performance printk.console_no_auto_verbose=1 kasan=off sysctl.kernel.sched_pelt_multiplier=4 can.stats_timer=0 pcie_ports=compat irqaffinity=0-2 disable_dma32=on no-steal-acc cgroup.memory=nokmem,nosocket slub_debug=- msm_drm.moorechip_dsi_display0=qcom,mdss_dsi_icna3512_dsc_cmd:";
};

&pm8550b_haptics {
	qcom,use-erm = <1>;
};

&L14B {
	regulator-min-microvolt = <2800000>;
	regulator-max-microvolt = <2800000>;
	qcom,init-voltage = <2800000>;
};
