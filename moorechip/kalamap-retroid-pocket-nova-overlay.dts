/dts-v1/;
/plugin/;

#include "kalamap-retroid-pocket-nova.dtsi"

/ {
	model = "Retroid Pocket Nova";
	compatible = "qcom,kalamap-hdk", "qcom,kalamap", "qcom,hdk";
	qcom,msm-id = <603 0x20000>;
	qcom,board-id = <0x1001f 0>;
	moorechip,device-id = <6>;
};
