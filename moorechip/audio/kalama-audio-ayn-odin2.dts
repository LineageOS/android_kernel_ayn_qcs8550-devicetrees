/dts-v1/;
/plugin/;

#include "kalama-audio-moorechip.dtsi"
#include "kalama-audio-moorechip-hdmi.dtsi"

/ {
	compatible = "qcom,kalama-hdk", "qcom,kalama", "qcom,hdk",
			"qcom,kalamap";
	qcom,msm-id = <603 0x20000>;
	qcom,board-id = <0x1001f 0>;
	moorechip,device-id = <1>;
};
